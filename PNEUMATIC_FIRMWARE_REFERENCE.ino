#include <WiFi.h>
#include <WiFiUdp.h>


// ============================================================
// FSR
// ============================================================

const int fsrPin = 34;


// ============================================================
// MDD3A 制御ピン
// ============================================================

// Motor 1 → 電磁弁
const int M1A = 25;
const int M1B = 27;

// Motor 2 → ポンプ
const int M2A = 26;
const int M2B = 33;


// ============================================================
// PWM設定
// ============================================================

const int freq = 1000;
const int resolution = 8;


// ============================================================
// 通常時のポンプPWM
// ============================================================

int pwmValue = 150;


// ============================================================
// 出力PWM
// ============================================================

int outputpwm = 0;

// 電磁弁
int outputpwm_valve = 0;


// ============================================================
// Wi-Fi / UDP設定
// ============================================================

const char* SSID = "InstantMuscle";
const char* PASS = "muscle12345";

const int UDP_PORT = 5000;

WiFiUDP udp;


// ============================================================
// Unityからのトリガー状態
// ============================================================

// true  → Unityのトリガーが押されている
// false → Unityのトリガーが離されている
bool unityRelief = false;


// ============================================================
// Unity通信タイムアウト
// ============================================================

// Unityから500ms以上通信が来なかった場合
// トリガーOFFとして扱う

const unsigned long HEARTBEAT_TIMEOUT_MS = 500;

unsigned long lastRecvMs = 0;


// ============================================================
// Motor 1を制御
// → 電磁弁
// ============================================================

void motor1Forward(int pwm)
{
  ledcWrite(M1A, pwm);
  ledcWrite(M1B, 0);
}


// ============================================================
// Motor 2を制御
// → ポンプ
// ============================================================

void motor2Forward(int pwm)
{
  ledcWrite(M2A, pwm);
  ledcWrite(M2B, 0);
}


// ============================================================
// 両方のモーターを停止
// ============================================================

void motorStop()
{
  ledcWrite(M1A, 0);
  ledcWrite(M1B, 0);

  ledcWrite(M2A, 0);
  ledcWrite(M2B, 0);
}


// ============================================================
// UnityからUDPを受信
//
// Unity側:
//
// トリガー押す
//      ↓
//      T
//
// トリガー離す
//      ↓
//      F
// ============================================================

void receiveUnityCommand()
{
  int packetSize = udp.parsePacket();

  if (packetSize <= 0)
  {
    return;
  }


  char buf[16] = {0};


  int len = udp.read(
    buf,
    sizeof(buf) - 1
  );


  if (len <= 0)
  {
    return;
  }


  // ==========================================================
  // Unityから T
  // → トリガーON
  // ==========================================================

  if (buf[0] == 'T')
  {
    unityRelief = true;

    Serial.println("Unity Trigger = ON");
  }


  // ==========================================================
  // Unityから F
  // → トリガーOFF
  // ==========================================================

  else if (buf[0] == 'F')
  {
    unityRelief = false;

    Serial.println("Unity Trigger = OFF");
  }


  // 最後に通信を受信した時刻
  lastRecvMs = millis();
}


// ============================================================
// setup
// ============================================================

void setup()
{
  Serial.begin(115200);


  // ==========================================================
  // ADC設定
  // ==========================================================

  analogReadResolution(12);


  // ==========================================================
  // PWM設定
  // ==========================================================

  ledcAttach(M1A, freq, resolution);
  ledcAttach(M1B, freq, resolution);

  ledcAttach(M2A, freq, resolution);
  ledcAttach(M2B, freq, resolution);


  // ==========================================================
  // 初期状態
  // ==========================================================

  motor1Forward(0);
  motor2Forward(pwmValue);


  // ==========================================================
  // Wi-Fiアクセスポイント
  // ==========================================================

  WiFi.softAP(
    SSID,
    PASS
  );


  Serial.println();
  Serial.println("================================");
  Serial.println("MDD3A + FSR + Unity Trigger");
  Serial.println("================================");

  Serial.print("SSID : ");
  Serial.println(SSID);

  Serial.print("IP : ");
  Serial.println(WiFi.softAPIP());

  Serial.print("UDP PORT : ");
  Serial.println(UDP_PORT);


  // ==========================================================
  // UDP開始
  // ==========================================================

  udp.begin(UDP_PORT);


  Serial.println();
  Serial.println("Unity:");
  Serial.println("Trigger ON  -> T");
  Serial.println("Trigger OFF -> F");
  Serial.println();
}


// ============================================================
// loop
// ============================================================

void loop()
{
  // ==========================================================
  // 1. UnityからUDP受信
  // ==========================================================

  receiveUnityCommand();


  // ==========================================================
  // 2. Unityとの通信状態確認
  // ==========================================================

  bool linkAlive =
    (millis() - lastRecvMs) < HEARTBEAT_TIMEOUT_MS;


  // 通信が切れた場合
  // トリガーOFFとして扱う

  if (!linkAlive)
  {
    unityRelief = false;
  }


  // ==========================================================
  // 3. シリアル入力
  // ==========================================================

  if (Serial.available() > 0)
  {
    char key = Serial.read();


    switch (key)
    {
      case 'w':

        pwmValue += 10;

        if (pwmValue > 255)
          pwmValue = 255;

        break;


      case 's':

        pwmValue -= 10;

        if (pwmValue < 0)
          pwmValue = 0;

        break;


      case 'm':

        pwmValue = 255;

        break;


      case '0':

        pwmValue = 0;

        break;
    }
  }


  // ==========================================================
  // 4. FSR読み取り
  // ==========================================================

  int adcValue = analogRead(fsrPin);

  float voltage =
    adcValue * 3.3 / 4095.0;


  // ==========================================================
  // 5. FSRによるリリーフ判定
  // ==========================================================

  bool fsrRelief = false;


  if (voltage > 1.0)
  {
    fsrRelief = true;
  }


  // ==========================================================
  // 6. リリーフ判定
  //
  // FSR OR Unityトリガー
  // ==========================================================

  bool relief =
    fsrRelief || unityRelief;


  // ==========================================================
  // 7. PWM出力決定
  // ==========================================================

  if (relief)
  {
    // --------------------------------------------------------
    // リリーフ動作
    //
    // ポンプ → PWM 90
    // 電磁弁 → PWM 200
    // --------------------------------------------------------

    outputpwm = 90;

    outputpwm_valve = 200;
  }
  else
  {
    // --------------------------------------------------------
    // 通常動作
    //
    // ポンプ → pwmValue
    // 電磁弁 → OFF
    // --------------------------------------------------------

    outputpwm = pwmValue;

    outputpwm_valve = 0;
  }


  // ==========================================================
  // 8. MDD3Aへ出力
  // ==========================================================

  if (outputpwm > 0)
  {
    // Motor 1 → 電磁弁
    motor1Forward(outputpwm_valve);

    // Motor 2 → ポンプ
    motor2Forward(outputpwm);
  }
  else
  {
    motorStop();
  }


  // ==========================================================
  // 9. シリアル表示
  // ==========================================================

  Serial.print("Voltage = ");
  Serial.print(voltage);


  Serial.print(" V | FSR = ");

  if (fsrRelief)
  {
    Serial.print("RELIEF");
  }
  else
  {
    Serial.print("NORMAL");
  }


  Serial.print(" | Trigger = ");

  if (unityRelief)
  {
    Serial.print("ON");
  }
  else
  {
    Serial.print("OFF");
  }


  Serial.print(" | Link = ");

  if (linkAlive)
  {
    Serial.print("OK");
  }
  else
  {
    Serial.print("LOST");
  }


  Serial.print(" | Pump = ");
  Serial.print(outputpwm);


  Serial.print(" | Valve = ");
  Serial.println(outputpwm_valve);


  delay(100);
}